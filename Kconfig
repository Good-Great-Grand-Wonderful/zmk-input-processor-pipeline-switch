## Kconfig
```kconfig
DT_COMPAT_ZMK_INPUT_PROCESSOR_PIPELINE_SWITCH := zmk,input-processor-pipeline-switch
DT_COMPAT_ZMK_BEHAVIOR_PIPELINE_SWITCH := zmk,behavior-pipeline-switch

config ZMK_INPUT_PROCESSOR_PIPELINE_SWITCH
	bool
	default $(dt_compat_enabled,$(DT_COMPAT_ZMK_INPUT_PROCESSOR_PIPELINE_SWITCH))
	imply SETTINGS

config ZMK_BEHAVIOR_PIPELINE_SWITCH
	bool
	default $(dt_compat_enabled,$(DT_COMPAT_ZMK_BEHAVIOR_PIPELINE_SWITCH))
	depends on ZMK_INPUT_PROCESSOR_PIPELINE_SWITCH
```

## dts/bindings/behaviors/zmk,behavior-pipeline-switch.yaml
```yaml
# Copyright (c) 2026 Vincent Franco
# SPDX-License-Identifier: MIT

description: |
  Sets the active pipeline of a zmk,input-processor-pipeline-switch processor
  to an absolute index.
    param1: target pipeline index (0..N-1, in child declaration order).
    param2: persist flag - 0 = apply only (live preview), non-zero = apply and
            save to flash (when the processor is `persistent`).

compatible: "zmk,behavior-pipeline-switch"

include: two_param.yaml

properties:
  processor:
    required: true
    type: phandle
    description: The pipeline-switch input processor to control.
```

## dts/bindings/input_processors/zmk,input-processor-pipeline-switch.yaml
```yaml
# Copyright (c) 2026 Vincent Franco
# SPDX-License-Identifier: MIT

description: |
  Input processor that routes events through one of several child pipelines
  of input processors. The active pipeline is selected at runtime via the
  zmk,behavior-pipeline-switch behavior and can be persisted to flash.
  Child nodes are the pipelines, indexed 0..N-1 in declaration order.

compatible: "zmk,input-processor-pipeline-switch"

include: ip_zero_param.yaml

properties:
  persistent:
    type: boolean
    description: |
      If enabled the active pipeline index is stored to flash and restored
      at power on. Requires the settings subsystem.
  save_delay:
    default: 2000
    type: int
    description: Debounce in milliseconds before saving the index to flash.
  default-index:
    default: 0
    type: int
    description: |
      Pipeline index made active at boot, before any persisted selection is
      restored. Lets boot-default differ from child declaration order.

child-binding:
  description: One selectable pipeline of input processors.

  properties:
    input-processors:
      type: phandle-array
      required: true
    label:
      type: string
      description: |
        Human-readable name for this pipeline, surfaced to host-facing config
        UIs via zip_pipeline_switch_label(). Defaults to the child node name.
```
